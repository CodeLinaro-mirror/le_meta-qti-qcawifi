## conf/layer.conf
```bitbake
BBFILES += "${LAYERDIR}/recipes/*/*.bb ${LAYERDIR}/recipes/*/*.bbappend ${LAYERDIR}/recipes-products/images/*.bbappend"
BBPATH .= ":${LAYERDIR}"
BBFILE_COLLECTIONS += "qti-qcawifi"
BBFILE_PRIORITY_qti-qcawifi = "12"
BBFILE_PATTERN_qti-qcawifi := "^${LAYERDIR}/"

LAYERSERIES_COMPAT_qti-qcawifi = "thud dunfell"
```
